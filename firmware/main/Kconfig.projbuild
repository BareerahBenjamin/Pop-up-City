## firmware/main/Kconfig.projbuild
```kconfig
menu "Pop-up City"
config PLANET_SERVER_ORIGIN
 string "HTTPS server origin"
 default "https://herstory.net.cn"
config PLANET_WIFI_SSID
 string
 default ""
config PLANET_WIFI_PASSWORD
 string
 default ""
config PLANET_NEARBY_MIN_RSSI
 int "Nearby RSSI threshold; verify on hardware"
 range -100 -20
 default -65
endmenu
```

## firmware/target-check/main/Kconfig.projbuild
```kconfig
menu "Pop-up City"
config PLANET_SERVER_ORIGIN
 string "HTTPS server origin"
 default "https://kunyuan.site"
config PLANET_WIFI_SSID
 string
 default ""
config PLANET_WIFI_PASSWORD
 string
 default ""
endmenu
```

## firmware/target-check/sdkconfig.defaults
```kconfig
CONFIG_IDF_TARGET="esp32c3"
CONFIG_ESPTOOLPY_FLASHSIZE_8MB=y
CONFIG_PARTITION_TABLE_CUSTOM=y
CONFIG_PARTITION_TABLE_CUSTOM_FILENAME="../partitions.csv"
CONFIG_ESP_CONSOLE_USB_SERIAL_JTAG=y
CONFIG_ESP_CONSOLE_SECONDARY_NONE=y
CONFIG_ESP_MAIN_TASK_STACK_SIZE=8192

CONFIG_MBEDTLS_CERTIFICATE_BUNDLE=y
CONFIG_MBEDTLS_DYNAMIC_BUFFER=y

CONFIG_BT_ENABLED=y
CONFIG_BT_NIMBLE_ENABLED=y
CONFIG_BT_NIMBLE_ROLE_CENTRAL=n
CONFIG_BT_NIMBLE_ROLE_PERIPHERAL=y
CONFIG_BT_NIMBLE_ROLE_BROADCASTER=y
CONFIG_BT_NIMBLE_ROLE_OBSERVER=y
CONFIG_BT_NIMBLE_MAX_CONNECTIONS=1
CONFIG_BT_NIMBLE_NVS_PERSIST=n
CONFIG_BT_CTRL_BLE_MAX_ACT=2
CONFIG_BT_NIMBLE_BLUFI_ENABLE=y
CONFIG_MBEDTLS_DHM_C=y
CONFIG_ESP_WIFI_STATIC_RX_BUFFER_NUM=6
CONFIG_ESP_WIFI_RX_BA_WIN=6
CONFIG_ESP_WIFI_DYNAMIC_RX_BUFFER_NUM=8
CONFIG_ESP_WIFI_DYNAMIC_TX_BUFFER_NUM=8
CONFIG_ESP_WIFI_IRAM_OPT=n
CONFIG_ESP_WIFI_RX_IRAM_OPT=n
```
